## arch/arm64/mach-exynos/Kconfig
```kconfig
# arch/arm64/mach-exynos/Kconfig
#
# Copyright (c) 2016 Samsung Electronics Co., Ltd.
#		http://www.samsung.com/
#
# Licensed under GPLv2

# Configuration options for the EXYNOS7

if ARCH_EXYNOS

menu "SAMSUNG EXYNOS SoCs Support"

choice
	prompt "Exynos device target"
	default MACH_EXYNOS7885_NONE

config MACH_EXYNOS7885_NONE
	bool "None"

config MACH_EXYNOS7885_JACKPOTLTE_EUR_OPEN
	bool "Galaxy A8 (SM-A530F)"
	select EXYNOS_DTBTOOL

config MACH_EXYNOS7885_JACKPOT2LTE_EUR_OPEN
	bool "Galaxy A8+ (SM-A730F)"
	select EXYNOS_DTBTOOL
	
config MACH_EXYNOS7885_JACKPOTLTE_CAN_OPEN
	bool "Galaxy A8 (SM-A530W)"
	select EXYNOS_DTBTOOL

endchoice

menuconfig EXYNOS_DTBTOOL
	bool "Build dtbtool for Exynos"
	select DTC
	default n
	help
	  Say Y here to build the dtbtool for Exynos,
	  which is necessary to create DTB images for
	  use in Exynos boot images.

if EXYNOS_DTBTOOL

config EXYNOS_DTBH_PLATFORM_CODE
	hex "Exynos DTBH hex platform code"
	default 0x50a6
	help
	  This value is verified by the bootloader
	  to determine if the DTB image is valid for
	  the device that the kernel is booting on.

config EXYNOS_DTBH_SUBTYPE_CODE
	hex "Exynos DTBH hex subtype code"
	default 0x217584da
	help
	  This value is verified by the bootloader
	  to determine if the DTB image is valid for
	  the device that the kernel is booting on.

config EXYNOS_DTBH_PAGE_SIZE
	int "Exynos DTBH page size"
	range 2048 131072
	default 2048
	help
	  Page size used to pad the DTB image.
	  It should be equal to the page size of
	  the Exynos boot image.
	  Must be divisible by 2048.

endif

endmenu

endif
```
